## conf/distro/openrnd-poky-systemd.conf
```bitbake
DISTRO = "openrnd-poky-systemd"
DISTRO_NAME = "OpenRnD Baseline (Poky/systemd)"
DISTRO_VERSION = "1.0+snapshot-${DATE}"
DISTRO_CODENAME ="openrnd-systemd"

MAINTAINER = "OpenRnD <info@open-rnd.pl>"

TARGET_VENDOR = "-poky"

LAYER_CONF_VERSION ?= "6"

# set preferred versions
PREFERRED_PROVIDER_udev ?= "systemd"
PREFERRED_PROVIDER_udev-utils ?= "systemd"
VIRTUAL-RUNTIME_init_manager = "systemd"
VIRTUAL-RUNTIME_initscripts = ""

DISTRO_FEATURES_append = " systemd"
DISTRO_FEATURES_BACKFILL_CONSIDERED = "sysvinit"
# default to systemd-networkd & systemd-resolved for network
PACKAGECONFIG_append_pn-systemd = " networkd resolved"

# use ipk
PACKAGE_CLASSES = "package_ipk"
```

## conf/layer.conf
```bitbake
# We have a conf and classes directory, add to BBPATH
BBPATH .= ":${LAYERDIR}"

# We have a packages directory, add to BBFILES
BBFILES += "${LAYERDIR}/recipes-*/*/*.bb \
            ${LAYERDIR}/recipes-*/*/*.bbappend"

# This should only be incremented on significant changes that will
# cause compatibility issues with other layers
LAYERVERSION_openrnd-layer = "1"

BBFILE_COLLECTIONS += "openrnd-layer"
BBFILE_PATTERN_openrnd-layer = "^${LAYERDIR}/"
BBFILE_PRIORITY_openrnd-layer = "6"
LAYERDEPENDS_openrnd-layer = "core"

LICENSE_PATH += "${LAYERDIR}/licenses"
```
